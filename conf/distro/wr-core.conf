## conf/distro/wr-core.conf
```bitbake
#
# SPDX-License-Identifier: MIT
# Copyright (c) 2022 Sergey Moryakov <sergey@nqnet.org>
#
# Name and version of the distribution
DISTRO_NAME     = "WR-Core"
DISTRO_VERSION  = "2022.11"
DISTRO          = "wr-core"
DISTRO_CODENAME = "wr-core"

TCLIBC = "musl"
TCLIBCAPPEND = ""
INHERIT += " openwrt-distro-defaults "
FULL_OPTIMIZATION="-Os -pipe ${DEBUG_FLAGS}"

ENABLE_WIDEC = "false"
ENABLE_WIDEC_class-native = "true"

USE_NLS="no"
IMAGE_LINGUAS = ""

DISTRO_FEATURES:libc-musl = " largefile"
MACHINE_ESSENTIAL_EXTRA_RDEPENDS = ""

PACKAGE_CLASSES = "package_ipk"

RRECOMMENDS:${KERNEL_PACKAGE_NAME}-base = ""

require conf/distro/include/no-static-libs.inc
require conf/distro/include/yocto-uninative.inc

INHERIT += "uninative"

BB_SIGNATURE_HANDLER ?= "OEEquivHash"
BB_HASHSERVE ??= "auto"


# Disable python usage in opkg-utils since it won't build with tiny config
PACKAGECONFIG:remove:pn-opkg-utils = "python"
```

## conf/layer.conf
```bitbake
# We have a conf and classes directory, add to BBPATH
BBPATH .= ":${LAYERDIR}"

# We have recipes-* directories, add to BBFILES
BBFILES += "${LAYERDIR}/recipes-*/*/*.bb \
            ${LAYERDIR}/recipes-*/*/*.bbappend"

BBFILE_COLLECTIONS += "meta-wr"
BBFILE_PATTERN_meta-wr = "^${LAYERDIR}/"
BBFILE_PRIORITY_meta-wr = "9"

LAYERDEPENDS_meta-wr = "core"
LAYERSERIES_COMPAT_meta-wr = "kirkstone"
```

## conf/machine/mango-t113.conf
```bitbake
SOC_FAMILY ??= ""
include conf/machine/include/soc-family.inc
require conf/machine/include/arm/armv7a/tune-cortexa7.inc


PREFERRED_PROVIDER_virtual/kernel ?= "linux-mainline"
PREFERRED_VERSION_linux-mainline ?= "6.0.%"

IMAGE_FSTYPES = "cpio.gz ext4 squashfs"

KERNEL_IMAGETYPE = "zImage"

SERIAL_CONSOLE ?= "115200 ttyS3"
MACHINE_FEATURES ?= "rtc serial usbgadget usbhost vfat"

# KERNEL_DEVICETREE:mango-t113 = "sun8i-v3s-licheepi-zero.dtb"
```
